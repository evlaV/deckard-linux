## Documentation/devicetree/bindings/display/panel/ayaneo,wt0600-2k.yaml
```yaml
# SPDX-License-Identifier: (GPL-2.0-only OR BSD-2-Clause)
%YAML 1.2
---
$id: http://devicetree.org/schemas/display/panel/ayaneo,wt0600-2k.yaml#
$schema: http://devicetree.org/meta-schemas/core.yaml#

title: Ayaneo WT0600/WT0630 2K dual-DSI video mode panel

maintainers:
  - Kancy Joe <kancy2333@outlook.com>

description:
  The WT0600 and WT0630 are 1440x2560 2K resolution panels
  that require dual DSI links.

allOf:
  - $ref: panel-common.yaml#

properties:
  compatible:
    enum:
      - ayaneo,wt0600-2k
      - ayaneo,wt0630-2k

  reg:
    maxItems: 1
    description: DSI virtual channel

  avdd-supply:
    description: Analog voltage supply regulator

  vdd-supply:
    description: Main power supply regulator

  vci-supply:
    description: Interface power supply regulator

  vddio-supply:
    description: Digital I/O voltage supply regulator

  reset-gpios:
    maxItems: 1
    description: Panel reset GPIO

  ports:
    $ref: /schemas/graph.yaml#/properties/ports

    properties:
      port@0:
        $ref: /schemas/graph.yaml#/properties/port
        description: DSI input port for primary DSI link

      port@1:
        $ref: /schemas/graph.yaml#/properties/port
        description: DSI input port for secondary DSI link

    required:
      - port@0
      - port@1

required:
  - compatible
  - reg
  - avdd-supply
  - vdd-supply
  - vci-supply
  - vddio-supply
  - reset-gpios
  - ports

unevaluatedProperties: false

examples:
  - |
    #include <dt-bindings/gpio/gpio.h>

    dsi@1a94000 {
        #address-cells = <1>;
        #size-cells = <0>;

        panel@0 {
            compatible = "ayaneo,wt0600-2k";
            reg = <0>;

            avdd-supply = <&vreg_l28a_3p0>;
            reset-gpios = <&tlmm 75 GPIO_ACTIVE_LOW>;

            ports {
                #address-cells = <1>;
                #size-cells = <0>;

                port@0 {
                    reg = <0>;
                    panel_in_0: endpoint {
                        remote-endpoint = <&dsi0_out>;
                    };
                };

                port@1 {
                    reg = <1>;
                    panel_in_1: endpoint {
                        remote-endpoint = <&dsi1_out>;
                    };
                };
            };
        };
    };

...
```

## Documentation/devicetree/bindings/power/maxim,max172xx.txt
```
Maxim Max17201/Max17205, MAX17300/1/2/3, MAX17320 and MAX17330 Stand-Alone ModelGauge m5 Fuel Gauge
~~~~~~~~~~~~~~~~~~~~~~~~~~~~~~~~~~~~~~~~~~~~~~~~~~~~~~~~~~~~

Required properties:
 - compatible      : should contain one of the following:
						"maxim,max17201"
						"maxim,max17205"
						"maxim,max17300"
						"maxim,max17301"
						"maxim,max17302"
						"maxim,max17303"
						"maxim,max17320"
						"maxim,max17330"
						"maxim,max17332"
 - reg             : I2C bus address of the device (0x36)

Optional properties:
 - maxim,rsense    : Rsense register value in miliOhm
 - maxim,talrt-min : Lower temperature limit(in DegreeC) that generates ALRT1 pin interrupt
 - maxim,talrt-max : Upper temperature limit(in DegreeC) that generates ALRT1 pin interrupt
 - maxim,valrt-min : Lower voltage limit(in mV) that generates ALRT1 pin interrupt
 - maxim,valrt-max : Upper voltage limit(in mV) that generates ALRT1 pin interrupt
 - maxim,salrt-min : Lower state of charge limit(in percent) that generates ALRT1 pin interrupt
 - maxim,salrt-max : Upper state of charge limit(in percent) that generates ALRT1 pin interrupt
 - maxim,ialrt-min : Lower current limit(in mA) that generates ALRT1 pin interrupt
 - maxim,ialrt-max : Upper current limit(in mA) that generates ALRT1 pin interrupt

Example:

	max17332@36 {
		compatible  = "maxim,max17332";
		status				= "okay";
		reg         = <0x36>;
		interrupt-parent	= <&gpio>;
		interrupts			= <16 0>;
		rsense      = <5>;      /* miliOhm */
		talrt-min   = <0>;       /* DegreeC */
		talrt-max   = <50>;      /* DegreeC */
		valrt-min   = <3000>;    /* mV */
		valrt-max   = <4500>;    /* mV */
		salrt-min   = <1>;       /* Percent */
		salrt-max   = <99>;      /* Percent */
		ialrt-min   = <(-5000)>; /* mA */
		ialrt-max   = <5000>;    /* mA */
	};
```

## drivers/media/platform/qcom/vcodec/iris/Kconfig
```kconfig
config VIDEO_QCOM_IRIS
        tristate "Qualcomm Iris V4L2 encoder/decoder driver"
        depends on VIDEO_DEV
        depends on ARCH_QCOM
        select QCOM_MDT_LOADER if ARCH_QCOM
        select QCOM_SCM
        select DMABUF_HEAPS
	select DMABUF_HEAPS_SYSTEM
        help
          This is a V4L2 driver for Qualcomm Iris video accelerator
          hardware. It accelerates encoding and decoding operations
          on various Qualcomm SoCs.
          To compile this driver as a module choose m here.
```
