## Documentation/devicetree/bindings/iio/adc/maxim,max34417.yaml
```yaml
# SPDX-License-Identifier: (GPL-2.0 OR BSD-2-Clause)
%YAML 1.2
---
$id: http://devicetree.org/schemas/iio/adc/maxim,max34417.yaml#
$schema: http://devicetree.org/meta-schemas/core.yaml#

title: Maxim MAX34417 Four-Channel High Dynamic Range Power Accumulator

maintainers:
  - Neil Armstrong <neil.armstrong@linaro.org>

description: |
  The MAX34417 is a specialized current and voltage monitor used to determine
  power consumption of portable systems. The device has a very wide dynamic
  range (20,000:1) that allows for the accurate measurement of power in such
  systems. The device is configured and monitored with a standard I2C/SMBus
  serial interface. The unidirectional current sensor offers precision
  high-side operation with a low full-scale sense voltage.

  Specifications about the device can be found at:
  https://www.analog.com/media/en/technical-documentation/data-sheets/max34417.pdf

properties:
  compatible:
    const: maxim,max34417

  "#address-cells":
    const: 1

  "#size-cells":
    const: 0

  reg:
    maxItems: 1

  vdd-supply: true
  vio-supply: true

patternProperties:
  "^channel@[0-3]$":
    $ref: adc.yaml
    type: object
    description:
      Represents the internal channels of the sensor.

    properties:
      reg:
        items:
          - minimum: 0
            maximum: 3

      label: true

      shunt-resistor-micro-ohms:
        description:
          Value in micro Ohms of the shunt resistor connected between the RS+ and RS- inputs.
        minimum: 1000
        maximum: 100000
        default: 1000

    required:
      - reg

    unevaluatedProperties: false

required:
  - compatible
  - reg

additionalProperties: false

examples:
  - |
    i2c {
        #address-cells = <1>;
        #size-cells = <0>;

        sensor@10 {
              compatible = "maxim,max34417";
              reg = <0x10>;

              #address-cells = <1>;
              #size-cells = <0>;

              channel@0 {
                  reg = <0>;
                  label = "ch0";
                  shunt-resistor-micro-ohms = <5000>;
              };

              channel@1 {
                  reg = <1>;
                  label = "ch1";
             };

              channel@2 {
                  reg = <2>;
             };
        };
    };
```

## Documentation/devicetree/bindings/soc/qcom/qcom,eud.yaml
```yaml
# SPDX-License-Identifier: (GPL-2.0 OR BSD-2-Clause)
%YAML 1.2
---
$id: http://devicetree.org/schemas/soc/qcom/qcom,eud.yaml#
$schema: http://devicetree.org/meta-schemas/core.yaml#

title: Qualcomm Embedded USB Debugger

maintainers:
  - Souradeep Chowdhury <quic_schowdhu@quicinc.com>

description:
  This binding is used to describe the Qualcomm Embedded USB Debugger, which is
  mini USB-hub implemented on chip to support USB-based debug capabilities.

properties:
  compatible:
    items:
      - enum:
          - qcom,sc7280-eud
          - qcom,sm8450-eud
      - const: qcom,eud

  reg:
    items:
      - description: EUD Base Register Region
      - description: EUD Mode Manager Register

  interrupts:
    description: EUD interrupt
    maxItems: 1

  phys:
    items:
      - description: USB2/HS PHY needed for EUD functionality

  phy-names:
    items:
      - const: usb2-phy

  usb-role-switch:
    $ref: /schemas/types.yaml#/definitions/flag
    description: Support role switch.

  ports:
    $ref: /schemas/graph.yaml#/properties/ports
    description:
      These ports is to be attached to the endpoint of the DWC3 controller node
      and type C connector node. The controller has the "usb-role-switch"
      property.

    properties:
      port@0:
        $ref: /schemas/graph.yaml#/properties/port
        description: This port is to be attached to the DWC3 controller.

      port@1:
        $ref: /schemas/graph.yaml#/properties/port
        description: This port is to be attached to the type C connector.

required:
  - compatible
  - reg
  - phys
  - phy-names
  - ports

additionalProperties: false

examples:
  - |
    eud@88e0000 {
           compatible = "qcom,sc7280-eud", "qcom,eud";
           reg = <0x88e0000 0x2000>,
                 <0x88e2000 0x1000>;
           phys = <&usb_2_hsphy>;
           phy-names = "usb2-phy";

           ports {
                   #address-cells = <1>;
                   #size-cells = <0>;
                   port@0 {
                           reg = <0>;
                           eud_ep: endpoint {
                                   remote-endpoint = <&usb2_role_switch>;
                           };
                   };

                   port@1 {
                           reg = <1>;
                           eud_con: endpoint {
                                   remote-endpoint = <&con_eud>;
                           };
                   };
           };
    };
```

## drivers/media/platform/qcom/camss/Kconfig
```kconfig
config VIDEO_QCOM_CAMSS
	tristate "Qualcomm V4L2 Camera Subsystem driver"
	depends on V4L_PLATFORM_DRIVERS
	depends on VIDEO_DEV
	depends on (ARCH_QCOM && IOMMU_DMA) || COMPILE_TEST
	select MEDIA_CONTROLLER
	select VIDEO_V4L2_SUBDEV_API
	select VIDEOBUF2_DMA_SG
	select VIDEOBUF2_VMALLOC
	select V4L2_FWNODE
	select V4L2_ISP

config VIDEO_QCOM_CAMSS_SM8650_VALVE
	bool "Use Valve's downstream SM8650 CAMSS backend"
	depends on VIDEO_QCOM_CAMSS
	default y
	help
	  Route SM8650 through Valve's downstream vfe-880 backend: NV12 on the
	  RDI0 node via the CSID IPP path, the extra output plane (DS4/DS16,
	  stats, frame headers), the per-VFE metadata nodes and the private
	  register ioctls used by Valve's userspace.

	  Say N to use the upstream SM8650 tables (vfe-780 with the PIX line).
```
